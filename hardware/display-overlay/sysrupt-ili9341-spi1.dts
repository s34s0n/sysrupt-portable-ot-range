/dts-v1/;
/plugin/;

/ {
    compatible = "brcm,bcm2712";

    fragment@0 {
        target = <&spi1>;
        __overlay__ {
            status = "okay";
            #address-cells = <1>;
            #size-cells = <0>;
            cs-gpios = <&gpio 16 1 >;

            ili9341@0 {
                compatible = "ilitek,ili9341";
                reg = <0>;
                spi-max-frequency = <32000000>;

                dc-gpios   = <&gpio 18 0>;
                reset-gpios = <&gpio 17 0>;

                rotation = <90>;

                panel-width-mm  = <49>;
                panel-height-mm = <37>;

                status = "okay";
            };
        };
    };
};
